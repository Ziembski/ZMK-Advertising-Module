## Kconfig
```kconfig
config ZMK_BLE_ADV
    bool "Enable ZMK BLE Status Advertisement"
    default n
    depends on ZMK_BLE
    select BT_EXT_ADV
    help
      Broadcast keyboard status as non-connectable BLE manufacturer data.
      Only the central half (or a standalone keyboard) will advertise.
      Peripheral halves remain silent to preserve split communication.

config BT_EXT_ADV_MAX_ADV_SET
    default 2 if ZMK_BLE_ADV

config ZMK_BLE_ADV_INTERVAL_MS
    int "Periodic advertisement interval in milliseconds"
    range 100 60000
    default 1000
    depends on ZMK_BLE_ADV
    help
      How often the status payload is broadcast when the keyboard is active
      (i.e. a keypress occurred within ZMK_BLE_ADV_IDLE_TIMEOUT_MS).

config ZMK_BLE_ADV_EVENT_THROTTLE_MS
    int "Minimum interval between event-triggered advertisements in milliseconds"
    range 50 5000
    default 200
    depends on ZMK_BLE_ADV
    help
      Keypresses, layer changes, and profile changes all trigger an immediate
      advertisement update. This value is the minimum time that must elapse
      between two such event-driven updates.

config ZMK_BLE_ADV_IDLE_TIMEOUT_MS
    int "Inactivity period before entering idle mode in milliseconds"
    range 1000 300000
    default 10000
    depends on ZMK_BLE_ADV
    help
      If no keypress is detected for this many milliseconds the module
      switches to the idle advertisement interval.

config ZMK_BLE_ADV_IDLE_INTERVAL_MS
    int "Advertisement interval in idle mode in milliseconds"
    range 1000 300000
    default 30000
    depends on ZMK_BLE_ADV
    help
      Advertisement interval used when the keyboard is idle. Set this to a
      value longer than the scanner's timeout to allow the scanner to detect
      the idle state. Must be greater than ZMK_BLE_ADV_INTERVAL_MS.

config ZMK_BLE_ADV_WPM_WINDOW_SECONDS
    int "WPM rolling window in seconds"
    range 5 60
    default 30
    depends on ZMK_BLE_ADV
    help
      Number of seconds used to compute the rolling words-per-minute value.
      Shorter windows react faster but are more noisy.

config ZMK_BLE_ADV_LAYER_NAMES
    bool "Include layer names in the advertisement payload"
    default y
    depends on ZMK_BLE_ADV
    help
      Uses zmk_keymap_layer_name() to embed the active layer's name in
      the payload. Requires a ZMK version that exposes this function
      (ZMK main branch, 2024+). Disable on older ZMK trees where the
      function is absent; the layer name field will fall back to "L<n>".
```
